/*
 * (C) Copyright 2016 Rockchip Electronics Co., Ltd
 *
 * SPDX-License-Identifier:     GPL-2.0+
 */

/dts-v1/;
#include "rk3399-rock-pi-4.dtsi"

/ {
	model = "Radxa ROCK Pi 4C";
	compatible = "radxa,rockpi4c", "rockchip,rk3399",
		     "google,rk3399evb-rev2";
};

&vcc5v0_host {
	gpio = <&gpio3 30 GPIO_ACTIVE_HIGH>;
};
